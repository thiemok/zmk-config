## Kconfig
```kconfig
config BOARD_STATUS_UNDERGLOW
    bool "Enable board status indication via underglow"
```

## boards/shields/dactyl5x6/Kconfig.defconfig
```kconfig
if SHIELD_DACTYL5X6_LEFT

config ZMK_KEYBOARD_NAME
	default "Dactyl 5x6"

config ZMK_SPLIT_ROLE_CENTRAL
	default y

endif

if  SHIELD_DACTYL5X6_LEFT || SHIELD_DACTYL5X6_RIGHT

config ZMK_SPLIT
	default y

endif
```

## boards/shields/dactyl5x6/Kconfig.shield
```kconfig
config SHIELD_DACTYL5X6_LEFT
	def_bool $(shields_list_contains,dactyl5x6_left)

config SHIELD_DACTYL5X6_RIGHT
	def_bool $(shields_list_contains,dactyl5x6_right)

config SHIELD_DACTYL5X6_DONGLE
	def_bool $(shields_list_contains,dactyl5x6_dongle)
```

## dts/bindings/zmk,board-status-underglow.yaml
```yaml
# Copyright (c) 2025 thiemok
# SPDX-License-Identifier: MIT

description: Indicates board status via underglow

compatible: "zmk,board-status-underglow"

properties: {}
```
